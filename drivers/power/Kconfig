## drivers/power/Kconfig
```kconfig
#ifdef VENDOR_EDIT
#/* Yichun.Chen  PSW.BSP.CHG  2019- */
config OPPO_SM7150_CHARGER
	tristate "CONFIG_OPPO_SM7150_CHARGER driver"
	help
	  Enables support for the oppo charging framework

config OPPO_SHORT_C_BATT_CHECK
	bool "OPPO batt short "
	help
	  Say Y here to declare OPPO batt short	 

config OPPO_RTC_DET_SUPPORT
	tristate "OPPO RTC DET SUPPORT"
	default n
	help
	  Say Y to include support

config OPPO_CHECK_CHARGERID_VOLT
	tristate "OPPO CHECK CHARGERID VOLT"
	default n
	help
	  Say Y to include support

config OPPO_SHIP_MODE_SUPPORT
	tristate "OPPO_SHIP_MODE_SUPPORT"
	default n
	help
	  Say Y to include support

config OPPO_SHORT_IC_CHECK
	bool "OPPO short ic"
	help
	  Say Y here to declare OPPO batt short

config OPPO_SHORT_HW_CHECK
	bool "OPPO batt HW SHORT "
	help
	  Say Y here to declare charging system is on MTK

config OPPO_CHIP_SOC_NODE
	bool "OPPO chip soc node"
	help
	  Say Y to include support

source "drivers/power/oppo/Kconfig"
#endif

source "drivers/power/avs/Kconfig"
source "drivers/power/reset/Kconfig"
source "drivers/power/supply/Kconfig"
```

## drivers/soc/oplus/Kconfig
```kconfig
#wen.luo@BSP.Kernel.Stability 2020/03/25 add for oplus kernel system
source "drivers/soc/oplus/system/Kconfig"
#endif /* VENDOR_EDIT */
```

## drivers/soc/oppo/Kconfig
```kconfig
config OPPO_ARCH_FILE
  bool "for build directory oppo"
  ---help---
  say Y to buid in

config OPPO_COMMON_SOFT
  bool "config oppo common software"
  select OPPO_ARCH_FILE
  help
	define this config to get project verion from sharemem.
	Maybe this value is from CDT or dynamic identify by hardware
	id.

config OPPO_DEVICE_IFNO
  bool "config oppo devinfo"
  select OPPO_ARCH_FILE
  help
	define this config to compile devinfo.c for device register
		.
source "drivers/soc/oppo/project_info/Kconfig"
source "drivers/soc/oppo/device_info/Kconfig"
source "drivers/soc/oppo/mdmrst/Kconfig"
source "drivers/soc/oppo/oppo_hypnus/Kconfig"
source "drivers/soc/oppo/oppo_healthinfo/Kconfig"
source "drivers/soc/oppo/oppo_shutdown_detect/Kconfig"
source "drivers/soc/oppo/oppo_criticallog/Kconfig"

#Kun.Hu@TECH.BSP.Stability.PHOENIX_PROJECT 2019/06/15, Add for PHOENIX_PROJECT
source "drivers/soc/oppo/oppo_phoenix/Kconfig"
#ifdef VENDOR_EDIT
#GaoTing.Gan@PSW.MultiMedia.MediaServer, 2019/03/07, Add for kevent feedback
source "drivers/soc/oppo/oppo_kevent_feedback/Kconfig"
#endif /* VENDOR_EDIT */
```
